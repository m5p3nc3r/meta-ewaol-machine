## meta-ewaol-ext/conf/layer.conf
```bitbake
BBPATH .= ":${LAYERDIR}"
BBFILES += "${LAYERDIR}/recipes-*/recipes-*/*/*.bb \
            ${LAYERDIR}/recipes-*/recipes-*/*/*.bbappend"

BBFILE_COLLECTIONS += "ewaol-ext"
BBFILE_PATTERN_ewaol-ext = "^${LAYERDIR}/"
BBFILE_PRIORITY_ewaol-ext = "6"
LAYERSERIES_COMPAT_ewaol-ext = "kirkstone"

BBFILES_DYNAMIC += " \
	meta-adlink-ampere:${LAYERDIR}/dynamic-recipes-ampere/recipes-*/*/*.bbappend \
"
```

## meta-ewaol-ext/conf/machine/azure-vm-arm64.conf
```bitbake
# Configuration for Azure EWAOL Virtual Machine

#@TYPE: Machine
#@NAME: Azure machine
#@DESCRIPTION: Machine configuration for Azure

require conf/machine/include/arm/armv8-2a/tune-neoversen1.inc

KERNEL_IMAGETYPE = "Image"

IMAGE_FSTYPES += "wic wic.gz"
WKS_FILE ?= "azure-disk.wks.in"

#grub-efi
EFI_PROVIDER ?= "grub-efi"
MACHINE_FEATURES += "efi"

# Kernel configuration
PREFERRED_PROVIDER_virtual/kernel ?= "linux-yocto"
KBUILD_DEFCONFIG = "defconfig"
KCONFIG_MODE = "--alldefconfig"
MACHINE_EXTRA_RRECOMMENDS += "kernel-modules linux-firmware"

# Ensure that azurelinuxagent is installed within the image.
# This is required for provisioning.
MACHINE_ESSENTIAL_EXTRA_RDEPENDS += "azurelinuxagent cloud-init"
```
